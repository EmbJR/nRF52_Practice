## prj.conf
```kconfig
#
# Copyright (c) 2017 Linaro Limited
#
# SPDX-License-Identifier: Apache-2.0
#

CONFIG_PRINTK=y
CONFIG_TIMESLICING=y
CONFIG_TIMESLICE_SIZE=10
CONFIG_TIMESLICE_PRIORITY=0


CONFIG_ENTROPY_GENERATOR=y
CONFIG_TEST_RANDOM_GENERATOR=y
```

## src/main.c
```c
#if 1
/*
 * Copyright (c) 2017 Linaro Limited
 *
 * SPDX-License-Identifier: Apache-2.0
 */

#include <zephyr/kernel.h>
#include <zephyr/sys/printk.h>
#include <string.h>
#include <zephyr/random/random.h> 

// Define stack size used by each thread
#define THREAD0_STACKSIZE      512
#define THREAD1_STACKSIZE      512

#define THREAD0_PRIORITY 5
#define THREAD1_PRIORITY 5

K_SEM_DEFINE(instance_monitor_sem, 10, 10);

volatile uint32_t available_instance_count = 10;

void release_access(void)
{
	k_sem_give(&instance_monitor_sem);
	available_instance_count++;
	printk("Resource given and available_instance_count = %d\n", k_sem_count_get(&instance_monitor_sem));
}

void get_access(void)
{
	k_sem_take(&instance_monitor_sem, K_FOREVER);
	available_instance_count--;
	printk("Resource taken and available_instance_count = %d\n",  k_sem_count_get(&instance_monitor_sem));
}

void producer(void)
{
	/* STEP 8 - Start the workqueue, */
	/* initialize the work item and connect it to its handler function */

	printk("Producer thread started\n");
	while (1) {
		release_access();
		k_msleep(sys_rand32_get() % 10);
	}
}

void consumer(void)
{

	printk("Consumer thread started\n");
	while (1) {
		get_access();
		k_msleep(sys_rand32_get() % 10);
	}  
}

/* STEP 4 - Define entry function for thread1 */

K_THREAD_DEFINE(thread0_id, THREAD0_STACKSIZE, producer, NULL, NULL, NULL, THREAD0_PRIORITY, 0, 0);
K_THREAD_DEFINE(thread1_id, THREAD1_STACKSIZE, consumer, NULL, NULL, NULL, THREAD1_PRIORITY, 0, 0);
#endif

#if 0
/*
 * Copyright (c) 2017 Linaro Limited
 *
 * SPDX-License-Identifier: Apache-2.0
 */

#include <zephyr/kernel.h>
#include <zephyr/sys/printk.h>
#include <string.h>
// Define stack size used by each thread
#define THREAD0_STACKSIZE      512
#define THREAD1_STACKSIZE      512
#define WORQ_THREAD_STACK_SIZE 512

/* STEP 2 - Set the priorities of the threads */
#define THREAD0_PRIORITY 2
#define THREAD1_PRIORITY 3
#define WORKQ_PRIORITY	 4

// Define stack area used by workqueue thread
static K_THREAD_STACK_DEFINE(my_stack_area, WORQ_THREAD_STACK_SIZE);

// Define queue structure
static struct k_work_q offload_work_q = {0};

/* STEP 5 - Define function to emulate non-urgent work */
static inline void emulate_work()
{
	for (volatile int count_out = 0; count_out < 300000; count_out++)
		;
}

/* STEP 7 - Create work_info structure and offload function */
struct work_info {
	struct k_work work;
	char name[25];
} my_work;

void offload_function(struct k_work *work_tem)
{
	emulate_work();
}

void thread0(void)
{
	uint64_t time_stamp;
	int64_t delta_time;
	/* STEP 8 - Start the workqueue, */
	/* initialize the work item and connect it to its handler function */
	k_work_queue_start(&offload_work_q, my_stack_area, K_THREAD_STACK_SIZEOF(my_stack_area),
			   WORKQ_PRIORITY, NULL);
	strcpy(my_work.name, "Thread0 emulate_work()");
	k_work_init(&my_work.work, offload_function);
	while (1) {
		time_stamp = k_uptime_get();
		/* STEP 9 - Submit the work item to the workqueue instead of calling emulate_work()
		 * directly */
		/* Remember to comment out emulate_work(); */
		k_work_submit_to_queue(&offload_work_q, &my_work.work);
		delta_time = k_uptime_delta(&time_stamp);
		printk("thread0 yielding this round in %lld ms\n", delta_time);
		k_msleep(20);
	}
}

/* STEP 4 - Define entry function for thread1 */
void thread1(void)
{
	uint64_t time_stamp;
	int64_t delta_time;

	while (1) {
		time_stamp = k_uptime_get();
		emulate_work();
		delta_time = k_uptime_delta(&time_stamp);

		printk("thread1 yielding this round in %lld ms\n", delta_time);
		k_msleep(20);
	}
}

K_THREAD_DEFINE(thread0_id, THREAD0_STACKSIZE, thread0, NULL, NULL, NULL, THREAD0_PRIORITY, 0, 0);
K_THREAD_DEFINE(thread1_id, THREAD1_STACKSIZE, thread1, NULL, NULL, NULL, THREAD1_PRIORITY, 0, 0);
#endif
```
