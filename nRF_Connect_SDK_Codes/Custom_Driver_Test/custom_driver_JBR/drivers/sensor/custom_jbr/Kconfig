## nRF_Connect_SDK_Codes/Device_Driver/custom_driver/Drivers/sensors/cust_sample_sens/Kconfig
```kconfig
config CUSTOM_DRIVER
    bool "Custom Driver Sample"
    depends on DT_HAS_ZEPHYR_CUSTOM_DRIVER_ENABLED
    select SPI
    help
        Enable custome drivers sample
```

## nRF_Connect_SDK_Codes/Device_Driver/custom_driver/Kconfig
```kconfig
rsource "Drivers/Kconfig"

config CUSTOM_DRIVER
    bool "Enable Custom Driver"
    help
      This option enables the custom driver for the nRF52832.
```
