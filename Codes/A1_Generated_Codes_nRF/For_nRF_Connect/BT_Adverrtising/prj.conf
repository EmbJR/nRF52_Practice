## CMakeLists.txt
```
cmake_minimum_required(VERSION 3.13.1)
find_package(Zephyr REQUIRED HINTS $ENV{ZEPHYR_BASE})
project(ai_advertiser)

target_sources(app PRIVATE src/main.c)
```

## prj.conf
```kconfig
CONFIG_BT=y
CONFIG_BT_PERIPHERAL=y
CONFIG_BT_DEVICE_NAME="AI_Advert_01"
CONFIG_LOG=y

CONFIG_CLOCK_CONTROL_NRF_K32SRC_RC=y
CONFIG_CLOCK_CONTROL_NRF_K32SRC_XTAL=n
```

## src/main.c
```c
#include <zephyr/kernel.h>
#include <zephyr/sys/printk.h>
#include <zephyr/sys/util.h>
#include <zephyr/bluetooth/bluetooth.h>
#include <zephyr/bluetooth/hci.h>
#include <zephyr/logging/log.h>
#include <stdint.h>
#include <stdio.h>
#include <string.h>

LOG_MODULE_REGISTER(ai_adv, LOG_LEVEL_INF);

/* Device name */
#define DEVICE_NAME "AI_Advert_01"

static uint32_t adv_counter = 1;

static void update_adv_string(char *buf, size_t buf_len, uint32_t cnt)
{
    /* Minimum 2 digits for small numbers, supports up to 65000 */
    snprintf(buf, buf_len, "Adv_%02u", (unsigned int)cnt);
}

void main(void)
{
    int err;
    char adv_str[16];

    LOG_INF("Starting AI advertiser sample");

    err = bt_enable(NULL);
    if (err) {
        LOG_ERR("Bluetooth init failed (err %d)", err);
        return;
    }

    bt_set_name(DEVICE_NAME);

    /* Prepare initial advertising data */
    update_adv_string(adv_str, sizeof(adv_str), adv_counter);

    /* Advertising parameters: non-connectable, 1 second interval (1600 * 0.625ms) */
    static const struct bt_le_adv_param adv_params = {
        .interval_min = 1600,
        .interval_max = 1600,
    };

    const struct bt_data init_ad[] = {
        BT_DATA(BT_DATA_NAME_COMPLETE, DEVICE_NAME, (uint8_t)(sizeof(DEVICE_NAME) - 1)),
        BT_DATA(BT_DATA_MANUFACTURER_DATA, adv_str, (uint8_t)strlen(adv_str)),
    };

    err = bt_le_adv_start(&adv_params, init_ad, ARRAY_SIZE(init_ad), NULL, 0);
    if (err) {
        LOG_ERR("Advertising start failed (err %d)", err);
        return;
    }

    LOG_INF("Advertising started: name=%s, payload=%s", DEVICE_NAME, adv_str);

    while (1) {
        k_sleep(K_SECONDS(1));

        /* increment and wrap at 65000 */
        adv_counter = (adv_counter >= 65000) ? 1 : adv_counter + 1;
        update_adv_string(adv_str, sizeof(adv_str), adv_counter);

        const struct bt_data ad_update[] = {
            BT_DATA(BT_DATA_NAME_COMPLETE, DEVICE_NAME, (uint8_t)(sizeof(DEVICE_NAME) - 1)),
            BT_DATA(BT_DATA_MANUFACTURER_DATA, adv_str, (uint8_t)strlen(adv_str)),
        };

        err = bt_le_adv_update_data(ad_update, ARRAY_SIZE(ad_update), NULL, 0);
        if (err) {
            LOG_WRN("bt_le_adv_update_data failed (err %d), restarting adv", err);
            bt_le_adv_stop();
            bt_le_adv_start(&adv_params, ad_update, ARRAY_SIZE(ad_update), NULL, 0);
        }
    }
}
```
