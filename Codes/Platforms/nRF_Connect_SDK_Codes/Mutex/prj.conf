## prj.conf
```kconfig
#
# Copyright (c) 2017 Linaro Limited
#
# SPDX-License-Identifier: Apache-2.0
#

CONFIG_PRINTK=y
CONFIG_TIMESLICING=y
CONFIG_TIMESLICE_SIZE=10
CONFIG_TIMESLICE_PRIORITY=0


CONFIG_ENTROPY_GENERATOR=y
CONFIG_TEST_RANDOM_GENERATOR=y

CONFIG_MULTITHREADING=y
```

## src/main.c
```c
#if 1
/*
 * Copyright (c) 2017 Linaro Limited
 *
 * SPDX-License-Identifier: Apache-2.0
 */

#include <zephyr/kernel.h>
#include <zephyr/sys/printk.h>
#include <string.h>
#include <zephyr/random/random.h> 

#define CREAT_OBJ(name) uint8_t name;

// Define stack size used by each thread
#define THREAD0_STACKSIZE      512
#define THREAD1_STACKSIZE      512

#define THREAD0_PRIORITY 5
#define THREAD1_PRIORITY 5

#define COMBINED_TOTAL   40
int32_t increment_count = 0; 
int32_t decrement_count = COMBINED_TOTAL; 

//K_SEM_DEFINE(instance_monitor_sem, 10, 10);
K_MUTEX_DEFINE(test_mutex);

CREAT_OBJ(JbrVal);


void shared_code_section()
{
	uint8_t race_condition = 0;
	int32_t increment_count_copy = 0;
	int32_t decrement_count_copy = 0;

	increment_count += 1;
	increment_count = increment_count % COMBINED_TOTAL; 

	decrement_count -= 1;
	if (decrement_count == 0) 
	{
		decrement_count = COMBINED_TOTAL;
	}

    if (increment_count + decrement_count != COMBINED_TOTAL) {
        race_condition = 1;
        increment_count_copy = increment_count;
        decrement_count_copy = decrement_count;
    }
    
    if( race_condition ){
        printk("Race condition happend!\n");
        printk("Increment_count (%d) + Decrement_count (%d) = %d \n", increment_count_copy,
            decrement_count_copy, (increment_count_copy + decrement_count_copy));
        k_msleep(400 + sys_rand32_get() % 10);
    }
}

void thread0(void)
{
	JbrVal = 20;
	printk("Thread 0 started %d\n", JbrVal);
	while (1) {
		k_mutex_lock(&test_mutex, K_FOREVER);
		shared_code_section(); 
		k_mutex_unlock(&test_mutex);
	}
}

void thread1(void)
{
	printk("Thread 1 started\n");
	while (1) {
		k_mutex_lock(&test_mutex, K_FOREVER);
		shared_code_section(); 
		k_mutex_unlock(&test_mutex);
	}
}
/* STEP 4 - Define entry function for thread1 */

K_THREAD_DEFINE(thread0_id, THREAD0_STACKSIZE, thread0, NULL, NULL, NULL, THREAD0_PRIORITY, 0, 0);
K_THREAD_DEFINE(thread1_id, THREAD1_STACKSIZE, thread1, NULL, NULL, NULL, THREAD1_PRIORITY, 0, 0);
#endif

#if 0
/*
 * Copyright (c) 2017 Linaro Limited
 *
 * SPDX-License-Identifier: Apache-2.0
 */

#include <zephyr/kernel.h>
#include <zephyr/sys/printk.h>
#include <string.h>
// Define stack size used by each thread
#define THREAD0_STACKSIZE      512
#define THREAD1_STACKSIZE      512
#define WORQ_THREAD_STACK_SIZE 512

/* STEP 2 - Set the priorities of the threads */
#define THREAD0_PRIORITY 2
#define THREAD1_PRIORITY 3
#define WORKQ_PRIORITY	 4

// Define stack area used by workqueue thread
static K_THREAD_STACK_DEFINE(my_stack_area, WORQ_THREAD_STACK_SIZE);

// Define queue structure
static struct k_work_q offload_work_q = {0};

/* STEP 5 - Define function to emulate non-urgent work */
static inline void emulate_work()
{
	for (volatile int count_out = 0; count_out < 300000; count_out++)
		;
}

/* STEP 7 - Create work_info structure and offload function */
struct work_info {
	struct k_work work;
	char name[25];
} my_work;

void offload_function(struct k_work *work_tem)
{
	emulate_work();
}

void thread0(void)
{
	uint64_t time_stamp;
	int64_t delta_time;
	/* STEP 8 - Start the workqueue, */
	/* initialize the work item and connect it to its handler function */
	k_work_queue_start(&offload_work_q, my_stack_area, K_THREAD_STACK_SIZEOF(my_stack_area),
			   WORKQ_PRIORITY, NULL);
	strcpy(my_work.name, "Thread0 emulate_work()");
	k_work_init(&my_work.work, offload_function);
	while (1) {
		time_stamp = k_uptime_get();
		/* STEP 9 - Submit the work item to the workqueue instead of calling emulate_work()
		 * directly */
		/* Remember to comment out emulate_work(); */
		k_work_submit_to_queue(&offload_work_q, &my_work.work);
		delta_time = k_uptime_delta(&time_stamp);
		printk("thread0 yielding this round in %lld ms\n", delta_time);
		k_msleep(20);
	}
}

/* STEP 4 - Define entry function for thread1 */
void thread1(void)
{
	uint64_t time_stamp;
	int64_t delta_time;

	while (1) {
		time_stamp = k_uptime_get();
		emulate_work();
		delta_time = k_uptime_delta(&time_stamp);

		printk("thread1 yielding this round in %lld ms\n", delta_time);
		k_msleep(20);
	}
}

K_THREAD_DEFINE(thread0_id, THREAD0_STACKSIZE, thread0, NULL, NULL, NULL, THREAD0_PRIORITY, 0, 0);
K_THREAD_DEFINE(thread1_id, THREAD1_STACKSIZE, thread1, NULL, NULL, NULL, THREAD1_PRIORITY, 0, 0);
#endif
```
